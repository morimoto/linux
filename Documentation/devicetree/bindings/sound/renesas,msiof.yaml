## Documentation/devicetree/bindings/sound/renesas,msiof.yaml
```yaml
# SPDX-License-Identifier: GPL-2.0
%YAML 1.2
---
$id: http://devicetree.org/schemas/sound/renesas,msiof.yaml#
$schema: http://devicetree.org/meta-schemas/core.yaml#

title: Renesas R-Car MSIOF (Clock-Synchronized Serial Interface with FIFO) I2S Interface

maintainers:
  - Kuninori Morimoto <kuninori.morimoto.gx@renesas.com>

allOf:
  - $ref: dai-common.yaml#

properties:
  compatible:
    oneOf:
      - items:
          - enum:
              - renesas,msiof-r8a7790       # R-Car H2
              - renesas,msiof-r8a7791       # R-Car M2-W
              - renesas,msiof-r8a7792       # R-Car V2H
              - renesas,msiof-r8a7793       # R-Car M2-N
              - renesas,msiof-r8a7794       # R-Car E2
          - const: renesas,rcar-gen2-msiof  # generic R-Car Gen2

      - items:
          - enum:
              - renesas,msiof-r8a7796       # R-Car M3-W
              - renesas,msiof-r8a77961      # R-Car M3-W+
              - renesas,msiof-r8a77965      # R-Car M3-N
              - renesas,msiof-r8a77970      # R-Car V3M
              - renesas,msiof-r8a77980      # R-Car V3H
              - renesas,msiof-r8a77980a     # R-Car V3H2
              - renesas,msiof-r8a77990      # R-Car E3
              - renesas,msiof-r8a77995      # R-Car D3
          - const: renesas,rcar-gen3-msiof  # Generic R-Car Gen3

  reg:
    maxItems: 1

  interrupts:
    maxItems: 1

  clocks:
    maxItems: 1

  power-domains:
    maxItems: 1

  '#sound-dai-cells':
    const: 1

patternProperties:
  "^fsi(a|b),spdif-connection$":
    $ref: /schemas/types.yaml#/definitions/flag
    description: FSI is connected by S/PDIF

  "^fsi(a|b),stream-mode-support$":
    $ref: /schemas/types.yaml#/definitions/flag
    description: FSI supports 16bit stream mode

  "^fsi(a|b),use-internal-clock$":
    $ref: /schemas/types.yaml#/definitions/flag
    description: FSI uses internal clock when master mode

required:
  - compatible
  - reg
  - interrupts
  - clocks
  - power-domains
  - '#sound-dai-cells'

unevaluatedProperties: false

examples:
  - |
    #include <dt-bindings/clock/r8a7740-clock.h>
    #include <dt-bindings/interrupt-controller/arm-gic.h>
    sh_fsi2: sound@fe1f0000 {
            compatible = "renesas,fsi2-r8a7740", "renesas,sh_fsi2";
            reg = <0xfe1f0000 0x400>;
            interrupts = <GIC_SPI 9 0x4>;
            clocks = <&mstp3_clks R8A7740_CLK_FSI>;
            power-domains = <&pd_a4mp>;

            #sound-dai-cells = <1>;
            fsia,spdif-connection;
            fsia,stream-mode-support;
            fsia,use-internal-clock;
    };
```
