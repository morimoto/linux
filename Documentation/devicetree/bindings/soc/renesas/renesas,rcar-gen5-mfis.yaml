## Documentation/devicetree/bindings/soc/renesas/renesas,rcar-gen5-mfis.yaml
```yaml
# SPDX-License-Identifier: (GPL-2.0-only OR BSD-2-Clause)
%YAML 1.2
---
$id: http://devicetree.org/schemas/soc/renesas/renesas,rcar-gen5-mfis.yaml#
$schema: http://devicetree.org/meta-schemas/core.yaml#

title: Renesas MFIS (Multifunctional Interface) controller

maintainers:
  - Kuninori Morimoto <kuninori.morimoto.gx@renesas.com>

description:
  Renesas multifunctional interface (MFIS) provides an interface between
  the different CPU Cores, such as AP System Core domain and the Realtime
  Core domain, SCP Core domain and AP System Core domain or Realtime Core
  domain and AP System Core domain or Realtime Core domain.
  The MFIS supports the issuing of interrupts for each CPU core domain.

properties:
  compatible:
    anyOf:
      # for MFIS-SCP
      - items:
          - enum:
              - renesas,r8a78000-mfis-scp
          - const: renesas,rcar-gen5-mfis-scp
      # for MFIS
      - items:
          - enum:
              - renesas,r8a78000-mfis
          - const: renesas,rcar-gen5-mfis

  reg-names:
    items:
      - const: common
      - const: mboxes

  reg:
    maxItems: 2

  "#mbox-cells":
    const: 3

required:
  - compatible
  - "#mbox-cells"

additionalProperties: false

examples:
  - |
    /*
     * Sample for MFIS
     */
    #include <dt-bindings/interrupt-controller/arm-gic.h>
    syscon@189e0000  {
        compatible = "renesas,r8a78000-mfis",
                     "renesas,rcar-gen5-mfis";
        status = "okay";
        reg = <0x189e0000 0x1000>, <0x18800000 0x40000>;
        reg-names = "common", "mboxes";
        #mbox-cells = <3>;
    };
```

## sound/soc/renesas/Kconfig
```kconfig
# SPDX-License-Identifier: GPL-2.0
menu "Renesas"
	depends on SUPERH || ARCH_RENESAS || COMPILE_TEST

##
## Audio unit modules
##

config SND_SOC_SH4_HAC
	tristate
	select AC97_BUS
	select SND_SOC_AC97_BUS

config SND_SOC_SH4_FSI
	tristate "SH4 FSI support"
	depends on SUPERH || COMMON_CLK
	select SND_SIMPLE_CARD
	help
	  This option enables FSI sound support

config SND_SOC_SH4_SIU
	tristate
	select FW_LOADER

config SND_SOC_RCAR
	tristate "R-Car series SRU/SCU/SSIU/SSI support"
	depends on COMMON_CLK
	depends on OF
	select SND_SIMPLE_CARD_UTILS
	select SND_DMAENGINE_PCM
	select REGMAP_MMIO
	help
	  This option enables R-Car SRU/SCU/SSIU/SSI sound support

config SND_SOC_MSIOF
	tristate "R-Car series MSIOF support"
	depends on OF
	select SND_DMAENGINE_PCM
	help
	  This option enables R-Car MSIOF sound support

config SND_SOC_RZ
	tristate "RZ/G2L series SSIF-2 support"
	depends on ARCH_RZG2L || COMPILE_TEST
	select SND_SOC_GENERIC_DMAENGINE_PCM
	help
	  This option enables RZ/G2L SSIF-2 sound support.

##
## Boards
##

config SND_SIU_MIGOR
	tristate "SIU sound support on Migo-R"
	depends on SUPERH && I2C
	depends on (SH_MIGOR && SH_DMAE) || COMPILE_TEST
	select SND_SOC_SH4_SIU
	select SND_SOC_WM8978
	help
	  This option enables sound support for the SH7722 Migo-R board

endmenu
```
